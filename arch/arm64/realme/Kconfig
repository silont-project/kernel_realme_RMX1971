## arch/arm64/realme/Kconfig
```kconfig
menu "Realme product selection"

config PRODUCT_REALME
	bool "Realme devices"
	help
	  This enables support for Realme devices.

if PRODUCT_REALME

config PRODUCT_REALME_SDM710
	bool "Realme SDM710-Common"

choice
	prompt "Realme device"

config PRODUCT_REALME_RMX1901
	bool "Realme X"
	select PRODUCT_REALME_SDM710
	help
	  This enables support for Realme X.

config PRODUCT_REALME_RMX1971
	bool "Realme 5 Pro"
	select PRODUCT_REALME_SDM710
	help
	  This enables support for Realme 5 Pro.

endchoice

endif

endmenu
```
